## CMakeLists.txt
```
cmake_minimum_required(VERSION 3.20.0)

find_package(Zephyr REQUIRED HINTS $ENV{ZEPHYR_BASE})
project(dwm1001_uwb)

target_include_directories(app PRIVATE include)

target_sources(app PRIVATE
  src/main.c
  src/platform/uwb_platform_zephyr.c
  src/drivers/dw1000.c
)

if(CONFIG_UWB_ROLE_TAG)
  target_sources(app PRIVATE
    src/ranging/tag_ranging.c
    src/filters/range_filter.c
    src/telemetry/telemetry.c
    src/telemetry/uart_tx_zephyr.c
  )
elseif(CONFIG_UWB_ROLE_ANCHOR)
  target_sources(app PRIVATE src/ranging/anchor_ranging.c)
else()
  target_sources(app PRIVATE
    src/diagnostics/hardware_test.c
    src/telemetry/uart_tx_zephyr.c
  )
endif()

target_compile_options(app PRIVATE
  -Wall
  -Wextra
  -Wformat=2
  -Wshadow
)
```

## Kconfig
```
mainmenu "DWM1001 UWB firmware"

source "Kconfig.zephyr"

menu "UWB application"

choice UWB_ROLE
  prompt "Node role"
  default UWB_ROLE_TAG

config UWB_ROLE_TAG
  bool "Tag"

config UWB_ROLE_ANCHOR
  bool "Anchor"

config UWB_ROLE_DIAGNOSTIC
  bool "DW1000 hardware diagnostic"

endchoice

config UWB_TAG_ADDRESS
  int "Tag short address"
  range 0 65534
  default 0

config UWB_ANCHOR_ADDRESS
  int "Anchor short address"
  range 1 65534
  default 1
  depends on UWB_ROLE_ANCHOR

config UWB_DS_TWR
  bool "Use four-message DS-TWR with SS fallback"
  default y

choice UWB_COMPENSATION
  prompt "Range compensation profile"
  default UWB_COMPENSATION_LEGACY

config UWB_COMPENSATION_LEGACY
  bool "Legacy software offsets"

config UWB_COMPENSATION_ANTENNA_DELAY
  bool "DW1000 hardware antenna delay"

endchoice

config UWB_CLOCK_CORRECTION
  bool "Carrier-integrator clock correction"
  default n

config UWB_TELEMETRY_ASCII
  bool "Human-readable CSV telemetry"
  default n
  depends on UWB_ROLE_TAG

config UWB_WATCHDOG
  bool "Enable hardware watchdog"
  default y

config UWB_WATCHDOG_TIMEOUT_MS
  int "Watchdog timeout (ms)"
  range 250 10000
  default 1000
  depends on UWB_WATCHDOG

endmenu
```

## prj.conf
```kconfig
# Core drivers used by the DWM1001 module.
CONFIG_GPIO=y
CONFIG_SPI=y
CONFIG_SERIAL=y
CONFIG_UART_INTERRUPT_DRIVEN=y
CONFIG_WATCHDOG=y

# The application talks to DW1000 registers directly because Zephyr's generic
# IEEE 802.15.4 driver does not expose delayed-TX/ranging timestamps required
# by this protocol state machine.
CONFIG_IEEE802154=n
CONFIG_IEEE802154_DW1000=n

# UART0 is reserved for framed telemetry. Keep all consoles/loggers away from it.
CONFIG_CONSOLE=n
CONFIG_UART_CONSOLE=n
CONFIG_RTT_CONSOLE=n
CONFIG_LOG=n
CONFIG_BOOT_BANNER=n
CONFIG_USE_SEGGER_RTT=n

CONFIG_MAIN_STACK_SIZE=4096
CONFIG_HEAP_MEM_POOL_SIZE=0

# Project defaults; config/*.conf selects the node role/address.
CONFIG_UWB_DS_TWR=y
CONFIG_UWB_COMPENSATION_LEGACY=y
CONFIG_UWB_CLOCK_CORRECTION=n
CONFIG_UWB_WATCHDOG=y
CONFIG_UWB_WATCHDOG_TIMEOUT_MS=1000
```

## src/main.c
```c
#include "anchor_ranging.h"
#include "dw1000_hw.h"
#include "hardware_test.h"
#include "tag_ranging.h"
#include "telemetry.h"
#include "uart_tx.h"
#include "uwb_platform.h"

#include <errno.h>
#include <zephyr/device.h>
#include <zephyr/devicetree.h>
#include <zephyr/drivers/watchdog.h>
#include <zephyr/kernel.h>

#define WATCHDOG_NODE DT_ALIAS(watchdog0)

static const struct device *const s_watchdog = DEVICE_DT_GET(WATCHDOG_NODE);
static int s_watchdog_channel = -1;

static int watchdog_start(void)
{
#ifdef CONFIG_UWB_WATCHDOG
    const struct wdt_timeout_cfg timeout = {
        .window = {
            .min = 0U,
            .max = CONFIG_UWB_WATCHDOG_TIMEOUT_MS,
        },
        .callback = NULL,
        .flags = WDT_FLAG_RESET_SOC,
    };

    if (!device_is_ready(s_watchdog)) {
        return -ENODEV;
    }

    s_watchdog_channel = wdt_install_timeout(s_watchdog, &timeout);
    if (s_watchdog_channel < 0) {
        return s_watchdog_channel;
    }

    int error = wdt_setup(s_watchdog,
                          WDT_OPT_PAUSE_HALTED_BY_DBG | WDT_OPT_PAUSE_IN_SLEEP);
    if (error == -ENOTSUP) {
        error = wdt_setup(s_watchdog, 0U);
    }
    return error;
#else
    return 0;
#endif
}

static void watchdog_feed(void)
{
#ifdef CONFIG_UWB_WATCHDOG
    if (s_watchdog_channel >= 0) {
        (void)wdt_feed(s_watchdog, s_watchdog_channel);
    }
#endif
}

static void fatal_blink(void)
{
    while (true) {
        uwb_platform_led_toggle();
        watchdog_feed();
        k_msleep(150);
    }
}

#if defined(CONFIG_UWB_ROLE_TAG)
static int run_tag(void)
{
    TagCycleSnapshot_t snapshot;
    uint32_t last_stats_ms;
    uint32_t last_cycle_count;
    uint32_t last_ok_count;

    if (UART_TX_Init() != 0 || Tag_Init() != 0) {
        return -EIO;
    }

    DW1000_EnableIRQ();
    Telem_SendInfo();
    last_stats_ms = uwb_platform_time_ms();
    last_cycle_count = tag_cycle_count;
    last_ok_count = response_ok_count;

    while (true) {
        /* IRQ is level-held by DW1000; polling closes the edge-race window. */
        if (DW1000_IrqLineActive() != 0U) {
            dw1000_irq_flag = 1U;
        }
        Tag_Task();

        if (tag_cycle_ready != 0U) {
            Tag_GetSnapshot(&snapshot);
            tag_cycle_ready = 0U;
            Telem_SendRangeCycle(&snapshot);
        }

        uint32_t now = uwb_platform_time_ms();
        if ((now - last_stats_ms) >= 1000U) {
            uint32_t elapsed = now - last_stats_ms;
            uint32_t cycles = tag_cycle_count - last_cycle_count;
            uint32_t successes = response_ok_count - last_ok_count;
            uint16_t cycle_hz = (uint16_t)((cycles * 1000U) / elapsed);
            uint16_t operation_hz = (uint16_t)((successes * 1000U) / elapsed);

            Telem_SendStats(cycle_hz, operation_hz);
            Telem_SendInfo();
            last_stats_ms = now;
            last_cycle_count = tag_cycle_count;
            last_ok_count = response_ok_count;
        }

        watchdog_feed();
        k_busy_wait(10U);
    }
}
#elif defined(CONFIG_UWB_ROLE_ANCHOR)
static int run_anchor(void)
{
    if (Anchor_Init() != 0) {
        return -EIO;
    }

    DW1000_EnableIRQ();
    Anchor_StartListening();

    while (true) {
        if (DW1000_IrqLineActive() != 0U) {
            dw1000_irq_flag = 1U;
        }
        Anchor_Task();
        watchdog_feed();
        k_busy_wait(10U);
    }
}
#else
static int run_hardware_test(void)
{
    int result = HardwareTest_Run();
    uint32_t blink_ms = result == 0 ? 200U : 1000U;

    while (true) {
        uwb_platform_led_toggle();
        watchdog_feed();
        k_msleep(blink_ms);
    }

    return 0;
}
#endif

int main(void)
{
    if (uwb_platform_init() != 0) {
        fatal_blink();
    }

    MCU_TimerInit();
    if (watchdog_start() != 0) {
        fatal_blink();
    }

#if defined(CONFIG_UWB_ROLE_TAG)
    if (run_tag() != 0) {
        fatal_blink();
    }
#elif defined(CONFIG_UWB_ROLE_ANCHOR)
    if (run_anchor() != 0) {
        fatal_blink();
    }
#else
    (void)run_hardware_test();
#endif

    return 0;
}
```

## include/dw1000_hw.h
```c
/**
  ******************************************************************************
  * @file    dw1000_hw.h
  * @brief   DW1000 UWB Hardware Driver — Shared Header
  *
 * The Zephyr port obtains SPI, CS, IRQ and reset pins from the DWM1001 board
 * devicetree. No MCU pin is hard-coded in this driver.
  *
  * This header is shared between Anchor and Tag projects.
  ******************************************************************************
  */

#ifndef DW1000_HW_H
#define DW1000_HW_H

#include <stdint.h>
#include "uwb_app_config.h"
#include "uwb_calibration.h"

/* ========================================================================== */
/*                     DW1000 REGISTER MAP                                     */
/* ========================================================================== */

#define DW_REG_DEV_ID       0x00    /* Device Identifier (4 bytes, RO) */
#define DW_REG_EUI          0x01    /* Extended Unique Identifier (8 bytes) */
#define DW_REG_PANADR       0x03    /* PAN ID and Short Address (4 bytes) */
#define DW_REG_SYS_CFG      0x04    /* System Configuration (4 bytes) */
#define DW_REG_SYS_TIME     0x06    /* System Time Counter (5 bytes, RO) */
#define DW_REG_TX_FCTRL     0x08    /* TX Frame Control (5 bytes) */
#define DW_REG_TX_BUFFER    0x09    /* TX Data Buffer (up to 1024 bytes) */
#define DW_REG_DX_TIME      0x0A    /* Delayed Send or Receive Time (5 bytes) */
#define DW_REG_SYS_CTRL     0x0D    /* System Control Register (4 bytes) */
#define DW_REG_SYS_MASK     0x0E    /* System Event Mask Register (4 bytes) */
#define DW_REG_SYS_STATUS   0x0F    /* System Event Status Register (5 bytes) */
#define DW_REG_RX_FINFO     0x10    /* RX Frame Information (4 bytes, RO) */
#define DW_REG_RX_BUFFER    0x11    /* RX Data Buffer (up to 1024 bytes, RO) */
#define DW_REG_RX_FQUAL     0x12    /* Receive Quality Data (8 bytes, RO) */
#define DW_REG_RX_TIME      0x15    /* RX Message Time of Arrival (14 bytes, RO) */
#define DW_REG_TX_TIME      0x17    /* TX Message Time of Sending (10 bytes, RO) */
#define DW_REG_TX_ANTD      0x18    /* TX Antenna Delay (2 bytes) */
#define DW_REG_CHAN_CTRL     0x1F    /* Channel Control (4 bytes) */
#define DW_REG_AGC_CTRL     0x23    /* AGC configuration and control block */
#define DW_REG_DRX_CONF     0x27    /* Digital Receiver configuration block */
#define DW_REG_RF_CONF      0x28    /* Analog RF configuration block */
#define DW_REG_TX_CAL       0x2A    /* Transmitter Calibration block */
#define DW_REG_FS_CTRL      0x2B    /* Frequency Synthesiser control block */
#define DW_REG_OTP_IF       0x2D    /* One-Time Programmable Memory IF */
#define DW_REG_LDE_IF       0x2E    /* Leading Edge Detection IF */
#define DW_REG_PMSC         0x36    /* Power Management and System Control */

/* ========================================================================== */
/*                     SUB-REGISTER OFFSETS                                    */
/* ========================================================================== */

/* AGC_CTRL sub-registers */
#define DW_SUB_AGC_TUNE1    0x04    /* AGC Tuning register 1 (2 bytes) */
#define DW_SUB_AGC_TUNE2    0x0C    /* AGC Tuning register 2 (4 bytes) */
#define DW_SUB_AGC_TUNE3    0x12    /* AGC Tuning register 3 (2 bytes) */

/* DRX_CONF sub-registers */
#define DW_SUB_DRX_TUNE0b   0x02   /* Digital Tuning 0b (2 bytes) */
#define DW_SUB_DRX_TUNE1a   0x04   /* Digital Tuning 1a (2 bytes) */
#define DW_SUB_DRX_TUNE1b   0x06   /* Digital Tuning 1b (2 bytes) */
#define DW_SUB_DRX_TUNE2    0x08   /* Digital Tuning 2 (4 bytes) */
#define DW_SUB_DRX_SFDTOC   0x20   /* SFD detection timeout (2 bytes) */
#define DW_SUB_DRX_TUNE4H   0x26   /* Digital Tuning 4H (2 bytes) */
#define DW_SUB_DRX_CAR_INT  0x28   /* Carrier Integrator (3 bytes, RO, 21-bit signed) */

/* RF_CONF sub-registers */
#define DW_SUB_RF_RXCTRLH   0x0B   /* RF RX Control (1 byte) */
#define DW_SUB_RF_TXCTRL    0x0C   /* RF TX Control (4 bytes) */

/* TX_CAL sub-registers */
#define DW_SUB_TC_PGDELAY   0x0B   /* Pulse Generator Delay (1 byte) */

/* FS_CTRL sub-registers */
#define DW_SUB_FS_PLLCFG    0x07   /* PLL Configuration (4 bytes) */
#define DW_SUB_FS_PLLTUNE   0x0B   /* PLL Tuning (1 byte) */

/* LDE_IF sub-registers (note: some use extended addressing) */
#define DW_SUB_LDE_CFG2     0x1806 /* LDE Configuration 2 (2 bytes) — extended */
#define DW_SUB_LDE_REPC     0x2804 /* LDE Replica Coefficient (2 bytes) — extended */

/* OTP_IF sub-registers */
#define DW_SUB_OTP_CTRL     0x06   /* OTP Control (2 bytes) */

/* PMSC sub-registers */
#define DW_SUB_PMSC_CTRL0   0x00   /* PMSC Control 0 (4 bytes) */

/* ========================================================================== */
/*                     SYS_STATUS BIT MASKS                                    */
/* ========================================================================== */

#define DW_TXFRS_BIT        (1UL << 7)   /* TX Frame Sent */
#define DW_RXPHD_BIT        (1UL << 11)  /* RX PHY Header Detected */
#define DW_RXPHE_BIT        (1UL << 12)  /* RX PHY Header Error */
#define DW_RXDFR_BIT        (1UL << 13)  /* RX Data Frame Ready */
#define DW_RXFCG_BIT        (1UL << 14)  /* RX FCS Good */
#define DW_RXFCE_BIT        (1UL << 15)  /* RX FCS Error */
#define DW_RXRFSL_BIT       (1UL << 16)  /* RX Reed Solomon Frame Sync Loss */
#define DW_RXRFTO_BIT       (1UL << 17)  /* RX Frame Wait Timeout */
#define DW_RXPTO_BIT        (1UL << 21)  /* Preamble Detection Timeout */
#define DW_TXPUTE_BIT       (1UL << 26)  /* TX Power Up Time Error (delayed TX) */
#define DW_HPDWARN_BIT      (1UL << 27)  /* Half Period Delay Warning (delayed TX late) */

/* Combined masks for convenience */
#define DW_ALL_RX_GOOD      (DW_RXDFR_BIT | DW_RXFCG_BIT)
#define DW_ALL_RX_ERR       (DW_RXFCE_BIT | DW_RXRFTO_BIT | DW_RXPTO_BIT | DW_RXPHE_BIT | DW_RXRFSL_BIT)
#define DW_ALL_TX_DONE      (DW_TXFRS_BIT)

/* ========================================================================== */
/*                     SYS_CTRL BIT MASKS                                      */
/* ========================================================================== */

#define DW_TXSTRT_BIT       (1UL << 1)   /* Transmit Start */
#define DW_TRXOFF_BIT       (1UL << 6)   /* Force TRX Off */
#define DW_RXENAB_BIT       (1UL << 8)   /* Enable Receiver */

/* ========================================================================== */
/*                     DEVICE ID                                               */
/* ========================================================================== */

#define DW1000_DEVICE_ID    0xDECA0130UL

/* ========================================================================== */
/*                     FRAME / PROTOCOL CONSTANTS                              */
/* ========================================================================== */

#define FRAME_POLL_FUNC     0x21    /* Function code: Poll message */
#define FRAME_RESP_FUNC     0x10    /* Function code: Response message */
#define FRAME_REPORT_FUNC   0x22    /* Function code: Report message (Distance) */
#define FRAME_FINAL_FUNC    0x23    /* Function code: Final message (future use) */

#define DW_PAN_ID           0xDECA  /* PAN Identifier */
/* ANCHOR_ADDR and TAG_ADDR are selected by Kconfig in uwb_app_config.h. */

/* Fast-50 profile: Ch5, 6.8Mbps, PRF16, preamble 256, PAC16, standard SFD.
 * DWT_PLEN_256 encoding is 0x24 in TX_FCTRL[21:18]. */
#define DW_PHY_PREAMBLE_SYMBOLS  256U
#define DW_PHY_PAC_SYMBOLS       16U
#define DW_PHY_SFD_TIMEOUT       249U  /* preamble + 1 + SFD(8) - PAC(16) */
#define DW_PHY_PROFILE_ID        2U    /* 0=unspecified, 1=legacy1024, 2=Fast-256 */
#define DW_TX_FCTRL_UPPER        0x0025C000UL

/* Runtime SPI starts at 2MHz for reset/OTP/LDE, then moves to 16MHz only
 * after DW1000 initialization. The driver automatically falls back to 8/2MHz
 * if the device-ID readback is not reliable at the faster rate. */
#define DW_SPI_INIT_MHZ          2U
#define DW_SPI_FAST_MHZ          8U
extern volatile uint8_t dw1000_spi_mhz;

/* Default antenna delay (calibration value for ~0.5m accuracy) */
#define DW_DEFAULT_ANT_DLY  16436   /* 0x4024 */

/* ========================================================================== */
/*                     RANGING RESULT STRUCTURE                                */
/* ========================================================================== */

/**
 * @brief Ranging result data — designed to be watched in the debugger
 */
typedef struct {
    int32_t  distance_mm;       /* Computed distance in millimeters */
    int32_t  distance_cm;       /* Computed distance in centimeters */
    uint8_t  poll_rx_ts[5];     /* Anchor: Poll RX timestamp (40-bit) */
    uint8_t  resp_tx_ts[5];     /* Anchor: Response TX timestamp (40-bit) */
    uint8_t  poll_tx_ts[5];     /* Tag: Poll TX timestamp (40-bit) */
    uint8_t  resp_rx_ts[5];     /* Tag: Response RX timestamp (40-bit) */
    uint32_t ranging_count;     /* Total successful ranging cycles */
    uint32_t timeout_count;     /* Total RX timeouts */
    uint32_t last_status;       /* Last SYS_STATUS value for debugging */
} DW1000_RangingResult;

/* ========================================================================== */
/*                     DIAGNOSTICS STRUCTURE                                   */
/* ========================================================================== */

/**
 * @brief Signal quality diagnostics for Kalman filter adaptive tuning
 */
typedef struct {
    uint16_t rxpacc;   /* Preamble accumulation count (N) */
    uint16_t fp_ampl1; /* First path amplitude 1 (F1) */
    uint16_t fp_ampl2; /* First path amplitude 2 (F2) */
    uint16_t fp_ampl3; /* First path amplitude 3 (F3) */
} DW1000_SignalDiag_t;

/* ========================================================================== */
/*                     API FUNCTION PROTOTYPES                                 */
/* ========================================================================== */

/**
 * @brief  Initialize the DW1000: GPIO setup, hardware reset, verify Device ID,
 *         and load LDE microcode from OTP memory.
 * @retval 0 = success, -1 = device ID mismatch, -2 = platform setup failure
 */
int DW1000_Init(void);

/**
 * @brief  Switch SPI from the <=3MHz initialization rate to the runtime rate.
 *         Call only after DW1000_Init() and DW1000_Configure().
 * @return Selected rate in MHz (16, 8, or 2); 0 if even the safe rate fails.
 */
uint8_t DW1000_EnableFastSPI(void);

/**
 * @brief  Configure DW1000 for Fast-256 ranging: Channel 5, PRF 16 MHz,
 *         Preamble 256, PAC16 and 6.8 Mbps.
 */
void DW1000_Configure(void);

/**
 * @brief  Set the PAN ID and Short Address in DW1000's PANADR register.
 * @param  pan_id  16-bit PAN identifier
 * @param  short_addr  16-bit short address
 */
void DW1000_SetAddress(uint16_t pan_id, uint16_t short_addr);

/**
 * @brief  Write data to the TX buffer.
 * @param  data  Pointer to frame data
 * @param  len   Number of bytes to write
 */
void DW1000_WriteTxData(const uint8_t *data, uint16_t len);

/**
 * @brief  Set the TX Frame Control register (frame length + config).
 * @param  len  Total frame length including 2-byte FCS
 */
void DW1000_SetTxFrameCtrl(uint16_t len);

/**
 * @brief  Start transmission by setting TXSTRT bit in SYS_CTRL.
 */
void DW1000_StartTx(void);

/**
 * @brief  Set the delayed TX time (DX_TIME register).
 * @param  tx_time  5-byte delayed transmit time (40-bit DW1000 timestamp)
 */
void DW1000_SetDelayedTxTime(const uint8_t tx_time[5]);

/**
 * @brief  Start delayed transmission (sets TXSTRT + TXDLYS bits) và kiểm tra
 *         ngay HPDWARN — nếu thời điểm phát đã trôi qua, TX sẽ không xảy ra.
 * @retval 0  = đã lên lịch TX thành công
 * @retval -1 = TRỄ (HPDWARN set) — caller phải recovery ngay, không chờ timeout (F-09)
 */
int DW1000_StartTxDelayed(void);

/**
 * @brief  Wait for TX to complete (poll SYS_STATUS for TXFRS).
 * @param  timeout_ms  Maximum wait time in milliseconds
 * @retval 1 = TX done, 0 = timeout
 */
int DW1000_WaitTxDone(uint32_t timeout_ms);

/**
 * @brief  Enable the receiver by setting RXENAB in SYS_CTRL.
 */
void DW1000_StartRx(void);

/**
 * @brief  Wait for a frame to be received.
 * @param  timeout_ms  Maximum wait time in milliseconds
 * @retval 0 = timeout, 1 = good frame, 2 = RX error
 */
int DW1000_WaitRxDone(uint32_t timeout_ms);

/**
 * @brief  Read received frame data from RX buffer.
 * @param  data     Buffer to store received data
 * @param  max_len  Maximum bytes to read
 * @retval Actual number of bytes read (from RX_FINFO)
 */
uint16_t DW1000_ReadRxData(uint8_t *data, uint16_t max_len);

/**
 * @brief  Read the 5-byte RX timestamp from RX_TIME register.
 * @param  ts  5-byte buffer to store the timestamp
 */
void DW1000_ReadRxTimestamp(uint8_t ts[5]);

/**
 * @brief  Read the 5-byte TX timestamp from TX_TIME register.
 * @param  ts  5-byte buffer to store the timestamp
 */
void DW1000_ReadTxTimestamp(uint8_t ts[5]);

/**
 * @brief  Read the signal quality diagnostics (RXPACC, FP_AMPL1-3)
 * @param  diag  Pointer to struct to store the diagnostics
 */
void DW1000_ReadSignalDiag(DW1000_SignalDiag_t* diag);

/**
 * @brief  Calculate the First Path Power (FPP) in dBm from diagnostics
 * @param  diag  Pointer to populated diagnostics struct
 * @retval FPP in dBm
 */
float DW1000_GetFirstPathPower(const DW1000_SignalDiag_t* diag);

/**
 * @brief  Read the Carrier Integrator (Frequency offset)
 * @retval 21-bit signed carrier integrator value
 */
int32_t DW1000_ReadCarrierIntegrator(void);

/**
 * @brief  Clear all status flags by writing 0xFFFFFFFF to SYS_STATUS.
 */
void DW1000_ClearAllStatus(void);

/**
 * @brief  Force receiver off by setting TRXOFF in SYS_CTRL.
 */
void DW1000_ForceRxOff(void);

/**
 * @brief  Read the SYS_STATUS register (4 bytes).
 * @retval 32-bit status value
 */
uint32_t DW1000_ReadStatus(void);

/**
 * @brief  Read the DW1000 Device ID register.
 * @retval 32-bit device ID (should be 0xDECA0130)
 */
uint32_t DW1000_ReadDeviceID(void);

/**
 * @brief  Configure the devicetree DW1000 IRQ pin as a rising-edge interrupt.
 *         Must be called AFTER DW1000_Init() +
 *         DW1000_Configure() + DW1000_ClearAllStatus().
 *
 * When DW1000 signals TX done or RX done, its IRQ remains HIGH until status
 * is cleared. The Zephyr GPIO callback sets dw1000_irq_flag = 1.
 * Application code must poll this flag and clear it.
 */
void DW1000_EnableIRQ(void);

/**
 * @brief  IRQ flag set by the Zephyr GPIO callback.
 *         Set to 1 on DW1000 IRQ rising edge.
 *         Must be cleared (set to 0) by the application after handling.
 */
extern volatile uint8_t dw1000_irq_flag;

/* ========================================================================== */
/*                     PHASE 2: µs TIMER, IRQ LEVEL, CONFIG VERIFY             */
/* ========================================================================== */

/**
 * @brief  Initialize the platform cycle timer abstraction.
 */
void MCU_TimerInit(void);

/**
 * @brief  Micro-giây kể từ MCU_TimerInit() (wrap ~67s @64MHz).
 *         CHỈ dùng cho giá trị tuyệt đối/log. KHÔNG dùng để tính delta/elapsed —
 *         dùng MCU_CycleNow() + MCU_ElapsedUs() cho mục đích đó (FIX-02).
 */
uint32_t MCU_Micros(void);

/**
 * @brief  FIX-02: kiểu dữ liệu "mốc cycle thô" — dùng làm điểm bắt đầu cho
 *         MCU_ElapsedUs(). KHÔNG phải microsecond, chỉ là snapshot CYCCNT thô.
 */
typedef uint32_t McuCycleStamp_t;

/**
 * @brief  FIX-02: Đọc mốc cycle thô hiện tại (CYCCNT). Dùng làm `start` cho
 *         MCU_ElapsedUs() thay vì lưu MCU_Micros() để tính delta timeout.
 */
McuCycleStamp_t MCU_CycleNow(void);

/**
 * @brief  FIX-02: Micro-giây đã trôi qua kể từ mốc `start` (MCU_CycleNow()).
 *         An toàn qua điểm wrap CYCCNT (~67s @64MHz) vì trừ RAW CYCCNT
 *         (uint32_t, tự động modulo 2^32 đúng chuẩn) TRƯỚC khi quy đổi sang µs.
 *         Khác MCU_Micros(): hàm đó quy đổi trước rồi nơi gọi mới trừ — SAI
 *         qua điểm wrap (xem FIX-02 trong FIRMWARE_CORRECTNESS_FIXES).
 */
uint32_t MCU_ElapsedUs(McuCycleStamp_t start);

/**
 * @brief  Read the active level of the DW1000 IRQ devicetree pin.
 * @retval 1 nếu IRQ đang HIGH (còn event chưa xử lý), 0 nếu LOW.
 *
 * IRQ của DW1000 là tín hiệu MỨC (giữ HIGH tới khi clear status). EXTI cạnh lên
 * có thể lỡ event thứ hai; poll mức này để bù (bổ sung F trong review).
 */
uint8_t DW1000_IrqLineActive(void);

/**
 * @brief  Đọc lại các thanh ghi PHY quan trọng và so với giá trị kỳ vọng.
 * @retval Bitmask các thanh ghi lệch (0 = tất cả khớp). Cho debug/telemetry (F-03).
 */
uint32_t DW1000_VerifyConfig(void);

/**
 * @brief  Đọc cảm biến nhiệt độ die của DW1000 (chuỗi SAR, ~1ms, BLOCKING).
 *         Chỉ gọi khi radio IDLE (vd lúc khởi động) — nó ghi tạm RF_CONF bias.
 * @retval Giá trị raw nhiệt độ (byte SAR). Xem Phase 3 plan mục 6 để đổi ra °C.
 */
uint8_t DW1000_ReadTemperatureRaw(void);

#endif /* DW1000_HW_H */
```

## include/hardware_test.h
```c
#ifndef HARDWARE_TEST_H
#define HARDWARE_TEST_H

int HardwareTest_Run(void);

#endif /* HARDWARE_TEST_H */
```

## include/motion_adaptive_range.h
```c
/**
 ******************************************************************************
 * @file    motion_adaptive_range.h
 * @brief   Allocation-free C9.2 range-motion regime controller.
 *
 * This module deliberately owns motion evidence and state transitions only.
 * Median filtering and scalar Kalman arithmetic stay in tag_ranging.c, so an
 * anchor still has exactly one canonical range estimator.  The module has no
 * HAL dependency and is shared by host tests and firmware.
 ******************************************************************************
 */

#ifndef MOTION_ADAPTIVE_RANGE_H
#define MOTION_ADAPTIVE_RANGE_H

#include <stdint.h>

typedef enum {
    MOTION_RANGE_REACQUIRE = 0U,
    MOTION_RANGE_STATIC = 1U,
    MOTION_RANGE_SLOW = 2U,
    MOTION_RANGE_FAST = 3U,
    MOTION_RANGE_SETTLING = 4U,
    MOTION_RANGE_DEGRADED = 5U,
} MotionAdaptiveRangeMode_t;

typedef struct {
    float slow_enter_z;
    float slow_exit_z;
    float fast_enter_z;
    float fast_exit_z;
    float cusum_drift_z;
    float slow_speed_mm_s;
    float fast_speed_mm_s;
    float slow_gain;
    float fast_gain;
    float settling_gain;
    float minimum_sigma_mm;
    float reacquire_min_fpp_dbm;
    float reacquire_cluster_mm;
    float max_radial_speed_mm_s;
    float gate_margin_up_mm;
    float gate_margin_down_mm;
    uint8_t slow_confirm_samples;
    uint8_t fast_confirm_samples;
    uint8_t settle_dwell_samples;
    uint8_t static_dwell_samples;
    uint8_t reacquire_samples;
    uint8_t degrade_after_rejects;
    uint32_t stale_reset_ms;
    uint32_t candidate_max_gap_ms;
    uint32_t min_dt_ms;
    uint32_t max_dt_ms;
} MotionAdaptiveRangeConfig_t;

typedef struct {
    uint8_t initialized;
    uint8_t mode;
    uint8_t slow_confirm_count;
    uint8_t fast_confirm_count;
    uint8_t quiet_count;
    uint8_t reacquire_count;
    uint8_t reject_streak;

    float positive_evidence;
    float negative_evidence;
    float last_median_mm;
    uint32_t last_median_tick;
    uint32_t last_sample_tick;

    float slope_history_mm_s[5];
    uint8_t slope_count;
    uint8_t slope_head;
    float last_slope_mm_s;
    float last_motion_score;

    float reacquire_mean_mm;
    uint32_t reacquire_last_tick;

    uint32_t static_enter_count;
    uint32_t slow_enter_count;
    uint32_t fast_enter_count;
    uint32_t settling_enter_count;
    uint32_t degraded_enter_count;
    uint32_t stale_reacquire_count;
    uint32_t true_reject_count;
} MotionAdaptiveRangeState_t;

typedef struct {
    uint8_t accepted;
    uint8_t publish_valid;
    uint8_t stale;
    uint8_t mode_changed;
    uint8_t previous_mode;
    float slope_mm_s;
    float motion_score;
} MotionAdaptiveRangeDecision_t;

static inline float MotionAdaptiveRange_Abs(float value)
{
    return value < 0.0f ? -value : value;
}

static inline uint32_t MotionAdaptiveRange_ElapsedMs(uint32_t now_ms,
                                                       uint32_t then_ms)
{
    /* Intentional uint32 arithmetic: correct across 32-bit uptime wrap. */
    return now_ms - then_ms;
}

static inline uint32_t MotionAdaptiveRange_ClampU32(uint32_t value,
                                                      uint32_t minimum,
                                                      uint32_t maximum)
{
    if (value < minimum)
        return minimum;
    if (value > maximum)
        return maximum;
    return value;
}

static inline float MotionAdaptiveRange_ClampF32(float value,
                                                  float minimum,
                                                  float maximum)
{
    if (value < minimum)
        return minimum;
    if (value > maximum)
        return maximum;
    return value;
}

static inline void MotionAdaptiveRange_ResetEvidence(MotionAdaptiveRangeState_t *state)
{
    state->slow_confirm_count = 0U;
    state->fast_confirm_count = 0U;
    state->quiet_count = 0U;
    state->positive_evidence = 0.0f;
    state->negative_evidence = 0.0f;
}

static inline void MotionAdaptiveRange_ResetReacquire(MotionAdaptiveRangeState_t *state)
{
    state->reacquire_count = 0U;
    state->reacquire_mean_mm = 0.0f;
    state->reacquire_last_tick = 0U;
}

static inline void MotionAdaptiveRange_Enter(MotionAdaptiveRangeState_t *state,
                                              uint8_t mode)
{
    if (state->mode == mode)
        return;

    state->mode = mode;
    if (mode == (uint8_t)MOTION_RANGE_STATIC)
        state->static_enter_count++;
    else if (mode == (uint8_t)MOTION_RANGE_SLOW)
        state->slow_enter_count++;
    else if (mode == (uint8_t)MOTION_RANGE_FAST)
        state->fast_enter_count++;
    else if (mode == (uint8_t)MOTION_RANGE_SETTLING)
        state->settling_enter_count++;
    else if (mode == (uint8_t)MOTION_RANGE_DEGRADED)
        state->degraded_enter_count++;
}

static inline void MotionAdaptiveRange_Init(MotionAdaptiveRangeState_t *state)
{
    uint8_t *bytes = (uint8_t *)state;
    uint32_t index;

    for (index = 0U; index < (uint32_t)sizeof(*state); index++)
        bytes[index] = 0U;
    state->mode = (uint8_t)MOTION_RANGE_REACQUIRE;
}

static inline uint8_t MotionAdaptiveRange_IsDynamic(uint8_t mode)
{
    return mode == (uint8_t)MOTION_RANGE_SLOW
        || mode == (uint8_t)MOTION_RANGE_FAST
        || mode == (uint8_t)MOTION_RANGE_SETTLING;
}

static inline float MotionAdaptiveRange_TargetGain(
    const MotionAdaptiveRangeState_t *state,
    const MotionAdaptiveRangeConfig_t *config)
{
    if (state->mode == (uint8_t)MOTION_RANGE_FAST)
        return config->fast_gain;
    if (state->mode == (uint8_t)MOTION_RANGE_SLOW)
        return config->slow_gain;
    if (state->mode == (uint8_t)MOTION_RANGE_SETTLING)
        return config->settling_gain;
    return 0.0f; /* STATIC retains the deployed low-Q Legacy update. */
}

/**
 * @brief Mark arrival of one valid radio distance before median/gate handling.
 * @retval 1 if a real stale gap requires the caller to clear its median state.
 */
static inline uint8_t MotionAdaptiveRange_BeginSample(
    MotionAdaptiveRangeState_t *state,
    uint32_t now_ms,
    const MotionAdaptiveRangeConfig_t *config)
{
    uint8_t stale = 0U;

    if (state->initialized != 0U
        && MotionAdaptiveRange_ElapsedMs(now_ms, state->last_sample_tick)
            > config->stale_reset_ms)
    {
        MotionAdaptiveRange_Enter(state, (uint8_t)MOTION_RANGE_REACQUIRE);
        MotionAdaptiveRange_ResetEvidence(state);
        MotionAdaptiveRange_ResetReacquire(state);
        state->reject_streak = 0U;
        state->slope_count = 0U;
        state->slope_head = 0U;
        state->last_median_mm = 0.0f;
        state->last_median_tick = 0U;
        state->last_slope_mm_s = 0.0f;
        state->last_motion_score = 0.0f;
        state->stale_reacquire_count++;
        stale = 1U;
    }

    state->initialized = 1U;
    state->last_sample_tick = now_ms;
    return stale;
}

static inline float MotionAdaptiveRange_MedianSlope(const MotionAdaptiveRangeState_t *state)
{
    float values[5];
    uint8_t count = state->slope_count;
    uint8_t i;
    uint8_t j;

    if (count == 0U)
        return 0.0f;
    for (i = 0U; i < count; i++)
        values[i] = state->slope_history_mm_s[i];
    for (i = 0U; i < count; i++)
    {
        for (j = (uint8_t)(i + 1U); j < count; j++)
        {
            if (values[i] > values[j])
            {
                float swap = values[i];
                values[i] = values[j];
                values[j] = swap;
            }
        }
    }
    if ((count & 1U) != 0U)
        return values[count / 2U];
    return (values[(count / 2U) - 1U] + values[count / 2U]) * 0.5f;
}

static inline void MotionAdaptiveRange_NoteAcceptedMedian(
    MotionAdaptiveRangeState_t *state,
    float median_mm,
    uint32_t now_ms,
    const MotionAdaptiveRangeConfig_t *config)
{
    if (state->last_median_tick != 0U)
    {
        uint32_t dt_ms = MotionAdaptiveRange_ElapsedMs(now_ms, state->last_median_tick);
        dt_ms = MotionAdaptiveRange_ClampU32(dt_ms,
                                              config->min_dt_ms,
                                              config->max_dt_ms);
        state->slope_history_mm_s[state->slope_head] =
            (median_mm - state->last_median_mm) * 1000.0f / (float)dt_ms;
        state->slope_head = (uint8_t)((state->slope_head + 1U) % 5U);
        if (state->slope_count < 5U)
            state->slope_count++;
    }
    state->last_median_mm = median_mm;
    state->last_median_tick = now_ms;
    state->last_slope_mm_s = MotionAdaptiveRange_MedianSlope(state);
}

/**
 * @brief Gate against the last accepted median, never a delayed Kalman state.
 */
static inline uint8_t MotionAdaptiveRange_AcceptKinematic(
    const MotionAdaptiveRangeState_t *state,
    float median_mm,
    uint32_t now_ms,
    const MotionAdaptiveRangeConfig_t *config)
{
    uint32_t dt_ms;
    float dt_s;
    float jump;
    float up_limit;
    float down_limit;

    if (state->last_median_tick == 0U)
        return 1U;

    dt_ms = MotionAdaptiveRange_ElapsedMs(now_ms, state->last_median_tick);
    dt_ms = MotionAdaptiveRange_ClampU32(dt_ms,
                                          config->min_dt_ms,
                                          config->max_dt_ms);
    dt_s = (float)dt_ms / 1000.0f;
    jump = median_mm - state->last_median_mm;
    up_limit = config->max_radial_speed_mm_s * dt_s + config->gate_margin_up_mm;
    down_limit = -(config->max_radial_speed_mm_s * dt_s + config->gate_margin_down_mm);
    return jump <= up_limit && jump >= down_limit ? 1U : 0U;
}

static inline void MotionAdaptiveRange_NoteReject(
    MotionAdaptiveRangeState_t *state,
    const MotionAdaptiveRangeConfig_t *config)
{
    if (state->reject_streak < 0xFFU)
        state->reject_streak++;
    state->true_reject_count++;
    if (state->reject_streak >= config->degrade_after_rejects)
    {
        MotionAdaptiveRange_Enter(state, (uint8_t)MOTION_RANGE_DEGRADED);
        MotionAdaptiveRange_ResetEvidence(state);
        MotionAdaptiveRange_ResetReacquire(state);
    }
}

/**
 * @brief Accumulate compatible medians after boot/stale/degraded state.
 * @retval 1 when a new canonical anchor range may be initialized to the mean.
 */
static inline uint8_t MotionAdaptiveRange_ObserveReacquire(
    MotionAdaptiveRangeState_t *state,
    float median_mm,
    float fpp_dbm,
    uint32_t now_ms,
    const MotionAdaptiveRangeConfig_t *config,
    float *mean_out)
{
    uint8_t compatible = 0U;

    if (fpp_dbm < config->reacquire_min_fpp_dbm)
    {
        MotionAdaptiveRange_ResetReacquire(state);
        return 0U;
    }

    if (state->reacquire_count != 0U
        && MotionAdaptiveRange_ElapsedMs(now_ms, state->reacquire_last_tick)
            <= config->candidate_max_gap_ms
        && MotionAdaptiveRange_Abs(median_mm - state->reacquire_mean_mm)
            <= config->reacquire_cluster_mm)
    {
        compatible = 1U;
    }

    if (compatible == 0U)
    {
        state->reacquire_count = 1U;
        state->reacquire_mean_mm = median_mm;
    }
    else
    {
        state->reacquire_count++;
        state->reacquire_mean_mm +=
            (median_mm - state->reacquire_mean_mm) / (float)state->reacquire_count;
    }
    state->reacquire_last_tick = now_ms;

    if (state->reacquire_count < config->reacquire_samples)
        return 0U;

    if (mean_out != 0)
        *mean_out = state->reacquire_mean_mm;
    MotionAdaptiveRange_Enter(state, (uint8_t)MOTION_RANGE_STATIC);
    MotionAdaptiveRange_ResetEvidence(state);
    MotionAdaptiveRange_ResetReacquire(state);
    state->reject_streak = 0U;
    return 1U;
}

static inline void MotionAdaptiveRange_UpdateEvidence(
    MotionAdaptiveRangeState_t *state,
    float innovation_mm,
    float sigma_mm,
    const MotionAdaptiveRangeConfig_t *config)
{
    float z;

    sigma_mm = sigma_mm < config->minimum_sigma_mm
        ? config->minimum_sigma_mm : sigma_mm;
    z = innovation_mm / sigma_mm;
    if (z >= 0.0f)
    {
        state->positive_evidence = MotionAdaptiveRange_ClampF32(
            state->positive_evidence + z - config->cusum_drift_z, 0.0f, 32.0f);
        state->negative_evidence = MotionAdaptiveRange_ClampF32(
            state->negative_evidence - z - config->cusum_drift_z, 0.0f, 32.0f);
    }
    else
    {
        state->negative_evidence = MotionAdaptiveRange_ClampF32(
            state->negative_evidence - z - config->cusum_drift_z, 0.0f, 32.0f);
        state->positive_evidence = MotionAdaptiveRange_ClampF32(
            state->positive_evidence + z - config->cusum_drift_z, 0.0f, 32.0f);
    }
    state->last_motion_score = state->positive_evidence > state->negative_evidence
        ? state->positive_evidence : state->negative_evidence;
}

/**
 * @brief Advance STATIC/SLOW/FAST/SETTLING after a kinematically accepted
 *        median.  The caller uses TargetGain() to select its scalar Kalman Q.
 */
static inline MotionAdaptiveRangeDecision_t MotionAdaptiveRange_ObserveAccepted(
    MotionAdaptiveRangeState_t *state,
    float median_mm,
    float innovation_mm,
    float sigma_mm,
    uint32_t now_ms,
    const MotionAdaptiveRangeConfig_t *config)
{
    MotionAdaptiveRangeDecision_t decision;
    uint8_t previous_mode = state->mode;
    uint8_t slow_evidence;
    uint8_t fast_evidence;
    uint8_t fast_still;
    uint8_t quiet;

    decision.accepted = 1U;
    decision.publish_valid = 1U;
    decision.stale = 0U;
    decision.mode_changed = 0U;
    decision.previous_mode = previous_mode;

    MotionAdaptiveRange_UpdateEvidence(state, innovation_mm, sigma_mm, config);
    MotionAdaptiveRange_NoteAcceptedMedian(state, median_mm, now_ms, config);

    slow_evidence = state->last_motion_score >= config->slow_enter_z
        && MotionAdaptiveRange_Abs(state->last_slope_mm_s) >= config->slow_speed_mm_s;
    fast_evidence = state->last_motion_score >= config->fast_enter_z
        && MotionAdaptiveRange_Abs(state->last_slope_mm_s) >= config->fast_speed_mm_s;
    fast_still = state->last_motion_score >= config->fast_exit_z
        && MotionAdaptiveRange_Abs(state->last_slope_mm_s) >= config->fast_speed_mm_s;
    quiet = state->last_motion_score <= config->slow_exit_z
        && MotionAdaptiveRange_Abs(state->last_slope_mm_s) <= config->slow_speed_mm_s;

    if (fast_evidence != 0U)
    {
        if (state->fast_confirm_count < 0xFFU)
            state->fast_confirm_count++;
    }
    else
    {
        state->fast_confirm_count = 0U;
    }
    if (slow_evidence != 0U)
    {
        if (state->slow_confirm_count < 0xFFU)
            state->slow_confirm_count++;
    }
    else if (state->mode != (uint8_t)MOTION_RANGE_FAST)
    {
        state->slow_confirm_count = 0U;
    }

    if (quiet != 0U)
    {
        if (state->quiet_count < 0xFFU)
            state->quiet_count++;
    }
    else
    {
        state->quiet_count = 0U;
    }

    if (state->mode == (uint8_t)MOTION_RANGE_STATIC)
    {
        if (state->fast_confirm_count >= config->fast_confirm_samples)
            MotionAdaptiveRange_Enter(state, (uint8_t)MOTION_RANGE_FAST);
        else if (state->slow_confirm_count >= config->slow_confirm_samples)
            MotionAdaptiveRange_Enter(state, (uint8_t)MOTION_RANGE_SLOW);
    }
    else if (state->mode == (uint8_t)MOTION_RANGE_SLOW)
    {
        if (state->fast_confirm_count >= config->fast_confirm_samples)
            MotionAdaptiveRange_Enter(state, (uint8_t)MOTION_RANGE_FAST);
        else if (state->quiet_count >= config->settle_dwell_samples)
            MotionAdaptiveRange_Enter(state, (uint8_t)MOTION_RANGE_SETTLING);
    }
    else if (state->mode == (uint8_t)MOTION_RANGE_FAST)
    {
        if (fast_still == 0U && slow_evidence != 0U)
            MotionAdaptiveRange_Enter(state, (uint8_t)MOTION_RANGE_SLOW);
        else if (state->quiet_count >= config->settle_dwell_samples)
            MotionAdaptiveRange_Enter(state, (uint8_t)MOTION_RANGE_SETTLING);
    }
    else if (state->mode == (uint8_t)MOTION_RANGE_SETTLING)
    {
        if (state->fast_confirm_count >= config->fast_confirm_samples)
            MotionAdaptiveRange_Enter(state, (uint8_t)MOTION_RANGE_FAST);
        else if (state->slow_confirm_count >= config->slow_confirm_samples)
            MotionAdaptiveRange_Enter(state, (uint8_t)MOTION_RANGE_SLOW);
        else if (state->quiet_count >= config->static_dwell_samples)
            MotionAdaptiveRange_Enter(state, (uint8_t)MOTION_RANGE_STATIC);
    }

    state->reject_streak = 0U;
    decision.mode_changed = state->mode != previous_mode ? 1U : 0U;
    decision.slope_mm_s = state->last_slope_mm_s;
    decision.motion_score = state->last_motion_score;
    return decision;
}

#endif /* MOTION_ADAPTIVE_RANGE_H */
```

## include/uart_tx.h
```c
#ifndef UART_TX_H
#define UART_TX_H

#include <stdint.h>

#define UART_TX_BUF_SIZE 1024U

extern volatile uint32_t uart_tx_overflow_count;

int UART_TX_Init(void);
uint32_t UART_TX_Write(const uint8_t *data, uint16_t length);
uint16_t UART_TX_Pending(void);

#endif /* UART_TX_H */
```

## include/uwb_app_config.h
```c
#ifndef UWB_APP_CONFIG_H
#define UWB_APP_CONFIG_H

#include <stdint.h>
#include <zephyr/autoconf.h>

#ifdef CONFIG_UWB_COMPENSATION_ANTENNA_DELAY
#define UWB_USE_HW_ANTENNA_DELAY 1
#define UWB_USE_LEGACY_OFFSET 0
#else
#define UWB_USE_HW_ANTENNA_DELAY 0
#define UWB_USE_LEGACY_OFFSET 1
#endif

#ifdef CONFIG_UWB_CLOCK_CORRECTION
#define UWB_USE_CLOCK_CORRECTION 1
#else
#define UWB_USE_CLOCK_CORRECTION 0
#endif

#ifdef CONFIG_UWB_DS_TWR
#define UWB_USE_DS_TWR 1
#else
#define UWB_USE_DS_TWR 0
#endif

#ifdef CONFIG_UWB_TELEMETRY_ASCII
#define TELEM_ASCII 1
#else
#define TELEM_ASCII 0
#endif

#define TAG_ADDR ((uint16_t)CONFIG_UWB_TAG_ADDRESS)

#ifdef CONFIG_UWB_ROLE_ANCHOR
#define ANCHOR_ADDR ((uint16_t)CONFIG_UWB_ANCHOR_ADDRESS)
#else
/* The TAG addresses anchors dynamically; this value is never used as a target. */
#define ANCHOR_ADDR ((uint16_t)1U)
#endif

#endif /* UWB_APP_CONFIG_H */
```

## include/uwb_platform.h
```c
#ifndef UWB_PLATFORM_H
#define UWB_PLATFORM_H

#include <stdbool.h>
#include <stddef.h>
#include <stdint.h>

int uwb_platform_init(void);
int uwb_platform_spi_set_frequency(uint32_t frequency_hz);
int uwb_platform_spi_transfer(const uint8_t *tx, uint8_t *rx, size_t length);
void uwb_platform_cs_set(bool active);
void uwb_platform_reset_radio(void);
void uwb_platform_enable_irq(void);
bool uwb_platform_irq_active(void);
void uwb_platform_delay_ms(uint32_t delay_ms);
void uwb_platform_delay_us(uint32_t delay_us);
uint32_t uwb_platform_time_ms(void);
uint32_t uwb_platform_cycle_now(void);
uint32_t uwb_platform_elapsed_us(uint32_t start_cycle);
void uwb_platform_led_toggle(void);
void uwb_platform_led_set(bool on);

#endif /* UWB_PLATFORM_H */
```
