## Firmware/ESP32C3_Gateway/sdkconfig.defaults
```kconfig
CONFIG_ESP_CONSOLE_NONE=y
CONFIG_ESP_CONSOLE_SECONDARY_NONE=y
CONFIG_BOOTLOADER_LOG_LEVEL_NONE=y
CONFIG_LOG_DEFAULT_LEVEL_NONE=y
CONFIG_LOG_MAXIMUM_EQUALS_DEFAULT=y
CONFIG_USJ_ENABLE_USB_SERIAL_JTAG=y
```
