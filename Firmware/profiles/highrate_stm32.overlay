/* The application exclusively owns SPI1 through the polled backend.
 * Keep its existing PA5/6/7 pinctrl and PA4 GPIO CS from the node overlay. */
&spi1 {
    status = "disabled";
};
&ieee802154 { spi-max-frequency = <16000000>; };
