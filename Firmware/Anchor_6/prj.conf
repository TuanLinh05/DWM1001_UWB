## CMakeLists.txt
```
cmake_minimum_required(VERSION 3.20.0)

find_package(Zephyr REQUIRED HINTS $ENV{ZEPHYR_BASE})
project(dwm1001_anchor_6)

# All sources are shared through Firmware/common; this directory only holds
# the node configuration (prj.conf, app.overlay, include/uwb_app_config.h).
include(${CMAKE_CURRENT_SOURCE_DIR}/../common/cmake/uwb_node.cmake)
uwb_node_setup(ANCHOR)
```

## prj.conf
```kconfig
# Anchor 6 only needs the DW1000 SPI/GPIO interface and watchdog.
CONFIG_GPIO=y
CONFIG_SPI=y
CONFIG_SERIAL=n
CONFIG_WATCHDOG=y
CONFIG_TIMING_FUNCTIONS=y

# Ranging needs delayed TX and 40-bit timestamps, so the application uses the
# register-level DW1000 driver instead of Zephyr's generic IEEE 802.15.4 API.
CONFIG_IEEE802154=n
CONFIG_IEEE802154_DW1000=n

CONFIG_CONSOLE=n
CONFIG_UART_CONSOLE=n
CONFIG_RTT_CONSOLE=n
CONFIG_LOG=n
CONFIG_BOOT_BANNER=n
CONFIG_USE_SEGGER_RTT=n

CONFIG_MAIN_STACK_SIZE=4096
CONFIG_HEAP_MEM_POOL_SIZE=0
```

## src/main.c
```c
#include "anchor_ranging.h"
#include "dw1000_hw.h"
#include "uwb_platform.h"

#include <errno.h>
#include <zephyr/device.h>
#include <zephyr/devicetree.h>
#include <zephyr/drivers/watchdog.h>
#include <zephyr/kernel.h>

#define WATCHDOG_NODE DT_ALIAS(watchdog0)

static const struct device *const s_watchdog = DEVICE_DT_GET(WATCHDOG_NODE);
static int s_watchdog_channel = -1;

static int watchdog_start(void)
{
#if UWB_WATCHDOG_ENABLED
    const struct wdt_timeout_cfg timeout = {
        .window = {
            .min = 0U,
            .max = UWB_WATCHDOG_TIMEOUT_MS,
        },
        .callback = NULL,
        .flags = WDT_FLAG_RESET_SOC,
    };

    if (!device_is_ready(s_watchdog)) {
        return -ENODEV;
    }

    s_watchdog_channel = wdt_install_timeout(s_watchdog, &timeout);
    if (s_watchdog_channel < 0) {
        return s_watchdog_channel;
    }

    int error = wdt_setup(s_watchdog,
                          WDT_OPT_PAUSE_HALTED_BY_DBG | WDT_OPT_PAUSE_IN_SLEEP);
    if (error == -ENOTSUP) {
        error = wdt_setup(s_watchdog, 0U);
    }
    return error;
#else
    return 0;
#endif
}

static void watchdog_feed(void)
{
#if UWB_WATCHDOG_ENABLED
    if (s_watchdog_channel >= 0) {
        (void)wdt_feed(s_watchdog, s_watchdog_channel);
    }
#endif
}

static void fatal_blink(void)
{
    while (true) {
        uwb_platform_led_toggle();
        watchdog_feed();
        k_msleep(150);
    }
}

static int run_anchor(void)
{
    if (Anchor_Init() != 0) {
        return -EIO;
    }

    DW1000_EnableIRQ();
    Anchor_StartListening();
    const uint32_t spi_errors_at_start = dw1000_spi_error_count;

    while (true) {
        /* IRQ is level-held by DW1000; polling closes the edge-race window. */
        if (DW1000_IrqLineActive() != 0U) {
            dw1000_irq_flag = 1U;
        }
        Anchor_Task();
        if (dw1000_spi_error_count != spi_errors_at_start) {
            return -EIO;
        }
        watchdog_feed();
        k_busy_wait(10U);
    }
}

int main(void)
{
    if (uwb_platform_init() != 0) {
        fatal_blink();
    }

    MCU_TimerInit();
    if (watchdog_start() != 0) {
        fatal_blink();
    }

    if (run_anchor() != 0) {
        fatal_blink();
    }

    return 0;
}
```

## include/uwb_app_config.h
```c
#ifndef UWB_APP_CONFIG_H
#define UWB_APP_CONFIG_H

#include <stdint.h>

/* Fixed identity for this standalone project. */
#define TAG_ADDR ((uint16_t)0U)
#define ANCHOR_ADDR ((uint16_t)6U)

/* Custom carrier profile; keep this identical to the Tag radio profile. */
#define UWB_USE_DS_TWR 1
#define UWB_USE_HW_ANTENNA_DELAY 1
#define UWB_USE_LEGACY_OFFSET 0
#define UWB_USE_CLOCK_CORRECTION 0
#define UWB_DS_CALIBRATED_MASK 0U
#define UWB_DS_OFFSET_A1_M 0.0
#define UWB_DS_OFFSET_A2_M 0.0
#define UWB_DS_OFFSET_A3_M 0.0
#define UWB_DS_OFFSET_A4_M 0.0
#define UWB_DS_OFFSET_A5_M 0.0
#define UWB_DS_OFFSET_A6_M 0.0
#define UWB_DS_OFFSET_A7_M 0.0
#define UWB_DS_OFFSET_A8_M 0.0

#define TELEM_ASCII 0

#define UWB_WATCHDOG_ENABLED 1
#define UWB_WATCHDOG_TIMEOUT_MS 1000U

#endif /* UWB_APP_CONFIG_H */
```
